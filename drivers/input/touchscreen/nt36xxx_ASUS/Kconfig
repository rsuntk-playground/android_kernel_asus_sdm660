## drivers/input/touchscreen/nt36xxx_ASUS/Kconfig
```kconfig
# SPDX-License-Identifier: GPL-2.0-only
#
# Novatek NT36xxx touchscreen driver configuration
#
config TOUCHSCREEN_NT36XXX_ASUS
	bool "ASUS X01BD and X00TD Novatek NT36xxx touchscreen driver"
	help
	  Say Y here if you have a Novatek NT36xxx touchscreen connected
	  to your system.

	  If unsure, say N.
```

## drivers/input/touchscreen/nt36xxx_X00TD/Kconfig
```kconfig
#
# Novatek NT36xxx touchscreen driver configuration
#
config TOUCHSCREEN_NT36XXX_X00TD
	bool "ASUS_X00TD Novatek NT36XXX touchscreen driver"
	depends on MACH_ASUS_X00TD
	default n
	help
	  Say Y here if you have a Novatek NT36xxx touchscreen connected
	  to your system.

	  If unsure, say N.
```

## drivers/input/touchscreen/nt36xxx_X01BD/Kconfig
```kconfig
#
# Novatek NT36xxx touchscreen driver configuration
#
config TOUCHSCREEN_NT36XXX_X01BD
	bool "ASUS_X01BD Novatek NT36xxx touchscreen driver"
	depends on MACH_ASUS_X01BD
	default n
	help
	  Say Y here if you have a Novatek NT36xxx touchscreen connected
	  to your system.

	  If unsure, say N.
```
